## components/link-core-board/Kconfig
```kconfig
menu "Link base board"

choice LINK_BOARD_REV
    prompt "Board revision"
    default LINK_BOARD_REV_A
    help
        Which revision of link-base-brd this firmware is built for.
        Selects the pin map. A binary built for one revision must not be
        flashed onto another - the GPIO assignments differ.

config LINK_BOARD_REV_A
    bool "Revision A"

endchoice

endmenu
```

## components/link-core-ui/Kconfig
```kconfig
menu "Link UI"

config LINK_SCREENSHOT
    bool "Screenshot command"
    default y
    help
        Keeps a copy of the frame on the panel, in PSRAM, and answers the
        "screenshot" protocol command with it. Costs H_RES x V_RES x 2
        bytes of PSRAM and one copy per flush.

endmenu
```
